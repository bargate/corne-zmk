## config/west.yml
```yaml
manifest:
  remotes:
    - name: zmkfirmware
      url-base: https://github.com/zmkfirmware
    - name: m165437 # gem
      url-base: https://github.com/M165437 # gem
  projects:
    - name: zmk
      remote: zmkfirmware
      revision: v0.3
      import: app/west.yml
    - name: nice-view-gem # gem
      remote: m165437 # gem
      revision: v0.3.0 # gem
  self:
    path: config
```
